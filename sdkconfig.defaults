## sdkconfig.defaults
```kconfig
CONFIG_EXAMPLE_LVGL_PORT_AVOID_TEAR_ENABLE=y
# CONFIG_EXAMPLE_LVGL_PORT_AVOID_TEAR_MODE_1 is not set
CONFIG_EXAMPLE_LVGL_PORT_AVOID_TEAR_MODE_2=y
# CONFIG_EXAMPLE_LVGL_PORT_AVOID_TEAR_MODE_3 is not set
CONFIG_EXAMPLE_LVGL_PORT_AVOID_TEAR_MODE=2

# Rotation for landscape mode
# CONFIG_EXAMPLE_LVGL_PORT_ROTATION_0 is not set
CONFIG_EXAMPLE_LVGL_PORT_ROTATION_90=y
# CONFIG_EXAMPLE_LVGL_PORT_ROTATION_180 is not set
# CONFIG_EXAMPLE_LVGL_PORT_ROTATION_270 is not set
CONFIG_EXAMPLE_LVGL_PORT_ROTATION_DEGREE=90

# Enable PPA for hardware-accelerated rotation
CONFIG_EXAMPLE_LVGL_PORT_PPA_ROTATION_ENABLE=y

# PSRAM Configuration (32MB available on hardware)
CONFIG_SPIRAM=y
CONFIG_SPIRAM_MODE_OCT=y
CONFIG_SPIRAM_SPEED_200M=y
CONFIG_SPIRAM_FETCH_INSTRUCTIONS=y
CONFIG_SPIRAM_RODATA=y
CONFIG_SPIRAM_USE_MALLOC=y

# Use PSRAM for LVGL buffers
CONFIG_EXAMPLE_LVGL_PORT_BUF_PSRAM=y
CONFIG_EXAMPLE_LVGL_PORT_BUF_HEIGHT=200


# ===== WiFi / SDIO Configuration (ESP-Hosted) =====
# Using ESP-Hosted with ESP32-C6 Slave (already flashed)
CONFIG_ESP_WIFI_REMOTE_ENABLED=y
CONFIG_ESP_HOSTED_INTERFACE_SDIO=y
CONFIG_ESP_HOSTED_SDIO_HOST_SLOT_1=y
CONFIG_ESP_HOSTED_SDIO_BLOCK_SIZE=512

# Slave Reset Pin (GPIO 54 on P4)
CONFIG_ESP_HOSTED_RESET_GPIO=54

# WiFi buffers
CONFIG_ESP_WIFI_STATIC_RX_BUFFER_NUM=10
CONFIG_ESP_WIFI_DYNAMIC_RX_BUFFER_NUM=32
CONFIG_ESP_WIFI_TX_BUFFER_TYPE=1
CONFIG_ESP_WIFI_DYNAMIC_TX_BUFFER_NUM=32

# ===== SNTP / NTP Configuration =====
CONFIG_LWIP_SNTP_UPDATE_DELAY=3600000

# ===== Flash Configuration =====
CONFIG_ESPTOOLPY_FLASHMODE_QIO=y
CONFIG_ESPTOOLPY_FLASHSIZE_16MB=y

# ===== Partition Table =====
CONFIG_PARTITION_TABLE_CUSTOM=y
CONFIG_PARTITION_TABLE_CUSTOM_FILENAME="partitions.csv"
CONFIG_PARTITION_TABLE_FILENAME="partitions.csv"
```
